## drivers/gpu/nova-core/Kconfig
```kconfig
config NOVA_CORE
	tristate "Nova Core GPU driver"
	depends on 64BIT
	depends on PCI
	depends on RUST
	select AUXILIARY_BUS
	select GPU_BUDDY
	select RUST_FW_LOADER_ABSTRACTIONS
	default n
	help
	  Choose this if you want to build the Nova Core driver for Nvidia
	  GPUs based on the GPU System Processor (GSP). This is true for Turing
	  and later GPUs.

	  This driver is work in progress and may not be functional.

	  If M is selected, the module will be called nova_core.

config NOVA_MM_SELFTESTS
	bool "Memory management self-tests"
	depends on NOVA_CORE
	help
	  Enable self-tests for the memory management subsystem. When enabled,
	  tests are run during GPU probe to verify PRAMIN aperture access,
	  page table walking, and BAR1 virtual memory mapping functionality.

	  This is a testing option and is default-disabled.
```

## drivers/media/virtio-v4l2/Kconfig
```kconfig
# SPDX-License-Identifier: GPL-2.0+
# Video driver for virtio

config VIRTIO_V4L2
	tristate "Virtio V4L2 driver"
	depends on VIRTIO && VIDEO_DEV
	depends on VIRTIO_MENU
	select VIRTIO_DMA_SHARED_BUFFER
	help
          Virtual v4l2 driver for virtio.
```
